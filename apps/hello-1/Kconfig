## apps/hello-1/Kconfig
```kconfig
#
# Copyright 2014, NICTA
#
# This software may be distributed and modified according to the terms of
# the BSD 2-Clause license. Note that NO WARRANTY is provided.
# See "LICENSE_BSD2.txt" for details.
#
# @TAG(NICTA_BSD)
#

menuconfig APP_HELLO_1
    bool "Hello World tutorial - v1"
    default y
    depends on LIB_SEL4 && (LIB_MUSL_C || LIB_SEL4_C) && LIB_SEL4_PLAT_SUPPORT && LIB_SEL4_UTILS && LIB_UTILS
    help
       Simple example of how to use the seL4 API and libraries - version 1. 
```

## apps/hello-3-nolibs/Kconfig
```kconfig
#
# Copyright 2015, NICTA
#
# This software may be distributed and modified according to the terms of
# the BSD 2-Clause license. Note that NO WARRANTY is provided.
# See "LICENSE_BSD2.txt" for details.
#
# @TAG(NICTA_BSD)
#

menuconfig APP_HELLO_3_NOLIBS
    bool "seL4 Hello World tutorial - v3 with no libraries"
    default n
    depends on LIB_SEL4 && (LIB_MUSL_C || LIB_SEL4_C) && LIB_SEL4_SIMPLE && LIB_SEL4_VKA && LIB_SEL4_ALLOCMAN && LIB_SEL4_VSPACE && LIB_SEL4_PLAT_SUPPORT
    help
       Simple example of how to use the seL4 API and libraries - version 3. 
```

## apps/hello-3/Kconfig
```kconfig
#
# Copyright 2014, NICTA
#
# This software may be distributed and modified according to the terms of
# the BSD 2-Clause license. Note that NO WARRANTY is provided.
# See "LICENSE_BSD2.txt" for details.
#
# @TAG(NICTA_BSD)
#

menuconfig APP_HELLO_3
    bool "Hello World tutorial - v3"
    default y
    depends on LIB_SEL4 && (LIB_MUSL_C || LIB_SEL4_C) && LIB_SEL4_VKA && LIB_SEL4_UTILS 
    help
       Simple example of how to use the seL4 API and libraries - version 3. 
```

## apps/hello-4-app/Kconfig
```kconfig
#
# Copyright 2014, NICTA
#
# This software may be distributed and modified according to the terms of
# the BSD 2-Clause license. Note that NO WARRANTY is provided.
# See "LICENSE_BSD2.txt" for details.
#
# @TAG(NICTA_BSD)
#

menuconfig APP_HELLO_4_APP
    bool "App for hello-4"
    default n
    depends on LIB_SEL4 && (LIB_MUSL_C || LIB_SEL4_C) && LIB_SEL4_MUSLC_SYS && LIB_UTILS
    help
        Contains the app that hello-4 starts.
```

## apps/hello-4/Kconfig
```kconfig
#
# Copyright 2014, NICTA
#
# This software may be distributed and modified according to the terms of
# the BSD 2-Clause license. Note that NO WARRANTY is provided.
# See "LICENSE_BSD2.txt" for details.
#
# @TAG(NICTA_BSD)
#

menuconfig APP_HELLO_4
    bool "Hello World seL4 tutorial - v4"
    default y
    depends on LIB_SEL4 && (LIB_MUSL_C || LIB_SEL4_C) && LIB_SEL4_VKA && LIB_SEL4_UTILS && LIB_SEL4_PLAT_SUPPORT && LIB_CPIO && LIB_ELF
    help
       Simple example of how to use the seL4 API and libraries - version 4. 
```

## exercises/hello-2-nolibs/Kconfig
```kconfig
#
# Copyright 2015, NICTA
#
# This software may be distributed and modified according to the terms of
# the BSD 2-Clause license. Note that NO WARRANTY is provided.
# See "LICENSE_BSD2.txt" for details.
#
# @TAG(NICTA_BSD)
#

menuconfig APP_HELLO_2_NOLIBS
    bool "seL4 Hello World tutorial - v2 with no libraries"
    default n
    depends on LIB_SEL4 && (LIB_MUSL_C || LIB_SEL4_C) && LIB_SEL4_DEBUG
    help
       Simple example of how to use the seL4 API and libraries - version 2. 
```

## exercises/hello-mcs/Kconfig
```kconfig
#
# Copyright 2017, Data61
# Commonwealth Scientific and Industrial Research Organisation (CSIRO)
# ABN 41 687 119 230.
#
# This software may be distributed and modified according to the terms of
# the BSD 2-Clause license. Note that NO WARRANTY is provided.
# See "LICENSE_BSD2.txt" for details.
#
# @TAG(DATA61_BSD)
#

menuconfig APP_HELLO_MCS
    bool "seL4 Hello World seL4 tutorial - MCS"
    default n
    depends on KERNEL_RT && LIB_SEL4 && (LIB_MUSL_C || LIB_SEL4_C) && LIB_SEL4_SIMPLE && \
               LIB_SEL4_VKA && LIB_SEL4_ALLOCMAN && LIB_SEL4_VSPACE && \
               LIB_SEL4_PLAT_SUPPORT && LIB_SEL4_UTILS && LIB_CPIO && \
               LIB_ELF && LIB_UTILS && LIB_SEL4_SIMPLE_DEFAULT && LIB_SEL4_DEBUG
    help
       Simple example of how to use the RT features of the MCS kernel.
```

## solutions/hello-2/Kconfig
```kconfig
#
# Copyright 2015, NICTA
#
# This software may be distributed and modified according to the terms of
# the BSD 2-Clause license. Note that NO WARRANTY is provided.
# See "LICENSE_BSD2.txt" for details.
#
# @TAG(NICTA_BSD)
#

menuconfig APP_HELLO_2
    bool "Hello World tutorial - v2"
    default n
    depends on LIB_SEL4 && (LIB_MUSL_C || LIB_SEL4_C) && LIB_SEL4_VKA && LIB_SEL4_UTILS 
    help
       Simple example of how to use the seL4 API and libraries - version 2. 
```

## solutions/hello-4-app/Kconfig
```kconfig
#
# Copyright 2017, Data61
# Commonwealth Scientific and Industrial Research Organisation (CSIRO)
# ABN 41 687 119 230.
#
# This software may be distributed and modified according to the terms of
# the BSD 2-Clause license. Note that NO WARRANTY is provided.
# See "LICENSE_BSD2.txt" for details.
#
# @TAG(DATA61_BSD)
#

menuconfig APP_HELLO_4_APP
    bool "App for hello-4"
    default n
    depends on LIB_SEL4 && (LIB_MUSL_C || LIB_SEL4_C) && LIB_SEL4_MUSLC_SYS && LIB_UTILS
    help
        Contains the app that hello-4 starts.
```

## solutions/hello-camkes-2/Kconfig
```kconfig
#
# Copyright 2015, NICTA
#
# This software may be distributed and modified according to the terms of
# the BSD 2-Clause license. Note that NO WARRANTY is provided.
# See "LICENSE_BSD2.txt" for details.
#
# @TAG(NICTA_BSD)
#

config APP_HELLO_CAMKES_2
    bool "CAmkES Hello World application with events and dataports"
    default n
    help
        Hello World application to demonstrate CAmkES events and dataports.
```

## solutions/hello-camkes-timer/Kconfig
```kconfig
#
# Copyright 2017, Data61
# Commonwealth Scientific and Industrial Research Organisation (CSIRO)
# ABN 41 687 119 230.
#
# This software may be distributed and modified according to the terms of
# the BSD 2-Clause license. Note that NO WARRANTY is provided.
# See "LICENSE_BSD2.txt" for details.
#
# @TAG(DATA61_BSD)
#

config APP_HELLO_CAMKES_TIMER
    bool "Simple CAmkES device driver application"
    default n
    help
        A simple application to demonstrate CAmkES device driver.
```

## solutions/hello-libs-1-bak/Kconfig
```kconfig
#
# Copyright 2014, NICTA
#
# This software may be distributed and modified according to the terms of
# the BSD 2-Clause license. Note that NO WARRANTY is provided.
# See "LICENSE_BSD2.txt" for details.
#
# @TAG(NICTA_BSD)
#

menuconfig APP_HELLO_LIBS_1
    bool "Hello World for libraries tutorial"
    default y
    depends on LIB_SEL4 && LIB_MUSL_C && LIB_SEL4_MUSLC_SYS && LIB_SEL4_PLAT_SUPPORT && LIB_CPIO && LIB_SEL4_ALLOCMAN && LIB_ELF && LIB_SEL4_VSPACE
    help
        Simple example of how to use seL4 libraries.
```

## solutions/hello-timer-client/Kconfig
```kconfig
#
# Copyright 2017, Data61
# Commonwealth Scientific and Industrial Research Organisation (CSIRO)
# ABN 41 687 119 230.
#
# This software may be distributed and modified according to the terms of
# the BSD 2-Clause license. Note that NO WARRANTY is provided.
# See "LICENSE_BSD2.txt" for details.
#
# @TAG(DATA61_BSD)
#

menuconfig APP_HELLO_TIMER_CLIENT
    bool "App for hello-timer"
    default n
    depends on LIB_SEL4 && (LIB_MUSL_C || LIB_SEL4_C) && LIB_SEL4_MUSLC_SYS && LIB_UTILS
    help
        Contains the app that hello-timer starts.
```

## solutions/hello-timer/Kconfig
```kconfig
#
# Copyright 2015, NICTA
#
# This software may be distributed and modified according to the terms of
# the BSD 2-Clause license. Note that NO WARRANTY is provided.
# See "LICENSE_BSD2.txt" for details.
#
# @TAG(NICTA_BSD)
#

menuconfig APP_HELLO_TIMER
    bool "seL4 Hello World seL4 tutorial - device driver"
    default n
    depends on LIB_SEL4 && (LIB_MUSL_C || LIB_SEL4_C) && LIB_SEL4_SIMPLE && LIB_SEL4_VKA && LIB_SEL4_ALLOCMAN && LIB_SEL4_VSPACE && LIB_SEL4_PLAT_SUPPORT && LIB_PLATSUPPORT && LIB_SEL4_UTILS && LIB_CPIO && LIB_ELF && LIB_UTILS
    help
       Simple example of how to use the seL4 drivers. 
```

## solutions/server-2/Kconfig
```kconfig
#
# Copyright 2015, NICTA
#
# This software may be distributed and modified according to the terms of
# the BSD 2-Clause license. Note that NO WARRANTY is provided.
# See "LICENSE_BSD2.txt" for details.
#
# @TAG(NICTA_BSD)
#

menuconfig APP_SERVER_2
    bool "seL4 RT server tutorial 2 solution"
    default n
    depends on LIB_SEL4 && (LIB_MUSL_C || LIB_SEL4_C) && LIB_SEL4_SIMPLE && \
               LIB_SEL4_VKA && LIB_SEL4_ALLOCMAN && LIB_SEL4_VSPACE && \
               LIB_SEL4_PLAT_SUPPORT && LIB_UTILS && LIB_SEL4_SIMPLE_DEFAULT && \
               LIB_SEL4_DEBUG
    help
       Simple example of how to use the seL4 RT API. 
```

## templates/hello-1/Kconfig
```kconfig
#
# Copyright 2017, Data61
# Commonwealth Scientific and Industrial Research Organisation (CSIRO)
# ABN 41 687 119 230.
#
# This software may be distributed and modified according to the terms of
# the BSD 2-Clause license. Note that NO WARRANTY is provided.
# See "LICENSE_BSD2.txt" for details.
#
# @TAG(DATA61_BSD)
#

menuconfig APP_HELLO_1
    bool "seL4 Hello World tutorial - v1"
    default n
    depends on LIB_SEL4 && (LIB_MUSL_C || LIB_SEL4_C) && LIB_SEL4_PLAT_SUPPORT && LIB_UTILS
    help
       Simple example of how to use the seL4 API and libraries - version 1. 
```

## templates/hello-2/Kconfig
```kconfig
#
# Copyright 2017, Data61
# Commonwealth Scientific and Industrial Research Organisation (CSIRO)
# ABN 41 687 119 230.
#
# This software may be distributed and modified according to the terms of
# the BSD 2-Clause license. Note that NO WARRANTY is provided.
# See "LICENSE_BSD2.txt" for details.
#
# @TAG(DATA61_BSD)
#

menuconfig APP_HELLO_2
    bool "seL4 Hello World tutorial - v2"
    default n
    depends on LIB_SEL4 && (LIB_MUSL_C || LIB_SEL4_C) && LIB_SEL4_SIMPLE && \
               LIB_SEL4_VKA && LIB_SEL4_ALLOCMAN && LIB_SEL4_PLAT_SUPPORT && \
               LIB_UTILS && LIB_SEL4_SIMPLE_DEFAULT && LIB_SEL4_DEBUG
    help
       Simple example of how to use the seL4 API and libraries - version 2. 
```

## templates/hello-3/Kconfig
```kconfig
#
# Copyright 2015, NICTA
#
# This software may be distributed and modified according to the terms of
# the BSD 2-Clause license. Note that NO WARRANTY is provided.
# See "LICENSE_BSD2.txt" for details.
#
# @TAG(NICTA_BSD)
#

menuconfig APP_HELLO_3
    bool "seL4 Hello World tutorial - v3"
    default n
    depends on LIB_SEL4 && (LIB_MUSL_C || LIB_SEL4_C) && LIB_SEL4_SIMPLE && \
               LIB_SEL4_VKA && LIB_SEL4_ALLOCMAN && LIB_SEL4_VSPACE && \
               LIB_SEL4_PLAT_SUPPORT && LIB_UTILS && LIB_SEL4_SIMPLE_DEFAULT && \
               LIB_SEL4_DEBUG
    help
       Simple example of how to use the seL4 API and libraries - version 3. 
```

## templates/hello-camkes-1/Kconfig
```kconfig
#
# Copyright 2017, Data61
# Commonwealth Scientific and Industrial Research Organisation (CSIRO)
# ABN 41 687 119 230.
#
# This software may be distributed and modified according to the terms of
# the BSD 2-Clause license. Note that NO WARRANTY is provided.
# See "LICENSE_BSD2.txt" for details.
#
# @TAG(DATA61_BSD)
#

config APP_HELLO_CAMKES_1
    bool "Simple CAmkES Hello World application"
    default n
    help
        A simple Hello World application to demonstrate CAmkES functionality.
```

## templates/hello-camkes-timer/Kconfig
```kconfig
#
# Copyright 2015, NICTA
#
# This software may be distributed and modified according to the terms of
# the BSD 2-Clause license. Note that NO WARRANTY is provided.
# See "LICENSE_BSD2.txt" for details.
#
# @TAG(NICTA_BSD)
#

config APP_HELLO_CAMKES_TIMER
    bool "Simple CAmkES device driver application"
    default n
    help
        A simple application to demonstrate CAmkES device driver.
```
